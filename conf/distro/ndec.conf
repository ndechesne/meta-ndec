## conf/distro/ndec.conf
```bitbake
CORE_IMAGE_EXTRA_INSTALL += "\
    coreutils \
    gptfdisk \
    cpufrequtils \
    connman \
"

VIRTUAL-RUNTIME_graphical_init_manager = ""

IMAGE_FEATURES_append = " ssh-server-dropbear"

INHERIT += "rm_work"
INHERIT += "image-buildinfo"
INHERIT += "buildhistory"

DISTRO_FEATURES_append = " opengl"

DISTRO_FEATURES_append = " systemd"
VIRTUAL-RUNTIME_init_manager = "systemd"
DISTRO_FEATURES_BACKFILL_CONSIDERED = "sysvinit"
PACKAGECONFIG_append_pn-systemd = " resolved networkd"

BUILDHISTORY_COMMIT = "1"

LICENSE_FLAGS_WHITELIST += "commercial_gstreamer1.0-libav commercial_libav commercial_x264"

PACKAGE_FEED_URIS = "http://10.42.0.1/opkg/msm"
```
